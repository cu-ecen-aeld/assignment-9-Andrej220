## base_external/package/aesd-assignments-socket/Config.in
```kconfig
config BR2_PACKAGE_AESD_ASSIGNMENTS_SOCKET
	bool "aesd-assignments-socket"
	help
	  Includes aesdsocket application to /bin and service startp/stop script into /etc/inti.d/
```

## base_external/package/aesdchar-assignment/Config.in
```kconfig
config BR2_PACKAGE_AESDCHAR_ASSIGNMENT
	bool "aesdchar-assignment"
	help
	  Includes aesdchar device 
```

## base_external/package/ldd-assignment/Config.in
```kconfig
config BR2_PACKAGE_LDD_ASSIGNMENT
	bool "ldd-assignment"
	help
	  Includes ldd based assignment7
```
